/dts-v1/;
/plugin/;

#include <dt-bindings/gpio/gpio.h>
#include <dt-bindings/pinctrl/am33xx.h>

/ {
	compatible = "ti,beaglebone", "ti,beaglebone-black";
	part_number = "GLOBALLOGIC-HW3";
	version = "A1";

	fragment@0 {
		target = <&am33xx_pinmux>;
		__overlay__ {
			hw3_pins: hw3_pins {
			pinctrl-single,pins = <
				/* gpmc_ad11.gpio0_27 */
				AM33XX_IOPAD(0x82c, PIN_INPUT | MUX_MODE7)
				/* gpmc_ad15.gpio1_15 */
				AM33XX_IOPAD(0x83c, PIN_OUTPUT | MUX_MODE7)
			>;
			};
		};
	};

	fragment@1 {
		target-path = "/";
		__overlay__ {
			hw3 {
				compatible = "globallogic,hw3";
				button-gpios = <&gpio0 27 GPIO_ACTIVE_LOW>;
				led-gpios = <&gpio1 15 GPIO_ACTIVE_HIGH>;
				debounce-delay-ms = <5>;
				wakeup-source;
				pinctrl-names = "default";
				pinctrl-0 = <&hw3_pins>;
			};
		};
	};
};
